/*
 * Copyright (c) 2020 The ZMK Contributors
 *
 * SPDX-License-Identifier: MIT
 */

#include "urchin.dtsi"

/ {
    chosen {
        /delete-property/ zmk,kscan; // No key scan device on dongle
    };

    kscan: kscan {
        compatible = "zmk,kscan-gpio-matrix";
        status = "disabled"; // Dongle has no matrix; prevent phantom presses (e.g. stuck Q)
        row-gpios = <&gpio0 0 GPIO_ACTIVE_LOW>;
        col-gpios = <&gpio0 0 GPIO_ACTIVE_LOW>;
    };
};
